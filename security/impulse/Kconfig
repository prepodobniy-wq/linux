## security/impulse/Kconfig
```kconfig
config SECURITY_IMPULSE
    bool "Impulse security module"
    depends on SECURITY
    default n
    help
      Impulse Guard: security monitor for Impulse Linux.
      If unsure, say N.
```
